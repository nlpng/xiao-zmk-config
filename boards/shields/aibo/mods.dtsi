#define HM_TAPPING_TERM 280
#define HM_TAPPING_TERM_FAST 200
#define QUICK_TAP_MS 175

/ {

    behaviors {

        // Positional Homerow mods
        // Homerow mods that prevent accidental activations when rolling keys,
        // such as when typing `st` or `ne` on colemak-dh layouts or `as` on
        // qwerty.
        //
        // Works by only allowing a mod to activate within tapping-term if
        // it's on the opposite side of the keyboard or on the same side thumb
        // keys.

        // Further optimization using urob's timerless homerow mods method:
        // https://github.com/urob/zmk-config#timeless-homerow-mods

        hml: homerow_mods_left {
            compatible = "zmk,behavior-hold-tap";
            #binding-cells = <2>;

            flavor = "balanced";
            tapping-term-ms = <280>;
            quick-tap-ms = <QUICK_TAP_MS>;
            require-prior-idle-ms = <150>;
            bindings = <&kp>, <&kp>;
            hold-trigger-key-positions = <KEYS_R KEYS_T>;
            hold-trigger-on-release;
        };

        hmr: homerow_mods_right {
            compatible = "zmk,behavior-hold-tap";
            #binding-cells = <2>;
            bindings = <&kp>, <&kp>;

            flavor = "balanced";
            tapping-term-ms = <280>;
            quick_tap_ms = <QUICK_TAP_MS>;
            require-prior-idle-ms = <150>;
            bindings = <&kp>, <&kp>;
            hold-trigger-key-positions = <KEYS_L KEYS_T>;
            hold-trigger-on-release;
        };
    };
};