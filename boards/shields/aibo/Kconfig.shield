## boards/shields/aibo/Kconfig.shield
```kconfig
config SHIELD_AIBO_RIGHT
    def_bool $(shields_list_contains,aibo_right)

config SHIELD_AIBO_LEFT
    def_bool $(shields_list_contains,aibo_left)
```

## boards/shields/sucker/Kconfig.defconfig
```kconfig
if SHIELD_SUCKER_RIGHT

config ZMK_KEYBOARD_NAME
    default "sucker_right"

config ZMK_SPLIT
    default y

config ZMK_SPLIT_ROLE_CENTRAL
    default y

endif

if SHIELD_SUCKER_LEFT

config ZMK_KEYBOARD_NAME
    default "sucker_left"

config ZMK_SPLIT
    default y

endif
```

## boards/shields/sucker/Kconfig.shield
```kconfig
config SHIELD_SUCKER_RIGHT
    def_bool $(shields_list_contains,sucker_right)

config SHIELD_SUCKER_LEFT
    def_bool $(shields_list_contains,sucker_left)
```

## config/Kconfig.defconfig
```kconfig
if SHIELD_SUCKER_RIGHT

config ZMK_KEYBOARD_NAME
    default "aibo_right"

config ZMK_SPLIT
    default y

config ZMK_SPLIT_ROLE_CENTRAL
    default y

endif

if SHIELD_SUCKER_LEFT

config ZMK_KEYBOARD_NAME
    default "aibo_left"

config ZMK_SPLIT
    default y

endif
```
